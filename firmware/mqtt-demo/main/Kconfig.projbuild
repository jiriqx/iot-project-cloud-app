## firmware/mqtt-demo/main/Kconfig.projbuild
```kconfig
menu "Project Configuration"

    menu "WiFi"
        config WIFI_SSID
            string "WiFi SSID"
            default "myssid"

        config WIFI_PASSWORD
            string "WiFi Password"
            default "mypassword"
    endmenu

    menu "MQTT"
        config MQTT_BROKER_URI
            string "MQTT Broker URI"
            default "mqtts://broker.example.com:8883"

        config MQTT_USERNAME
            string "MQTT Username"
            default ""

        config MQTT_PASSWORD
            string "MQTT Password"
            default ""

        config MQTT_GATEWAY_ID
            string "Gateway ID"
            default "gateway-1"
    endmenu

endmenu
```
